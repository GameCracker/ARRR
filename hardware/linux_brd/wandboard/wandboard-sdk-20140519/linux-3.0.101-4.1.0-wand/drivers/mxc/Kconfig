## hardware/linux_brd/wandboard/wandboard-sdk-20140519/linux-3.0.101-4.1.0-wand/drivers/mxc/Kconfig
```kconfig
# drivers/video/mxc/Kconfig

if ARCH_MXC

menu "MXC support drivers"

config MXC_IPU
	bool "Image Processing Unit Driver"
	depends on !ARCH_MX21
	depends on !ARCH_MX27
	depends on !ARCH_MX25
	select MXC_IPU_V1 if !ARCH_MX37 && !ARCH_MX5 && !ARCH_MX6Q
	select MXC_IPU_V3 if ARCH_MX37 || ARCH_MX5 || ARCH_MX6Q
	select MXC_IPU_V3D if ARCH_MX37
	select MXC_IPU_V3EX if ARCH_MX5
	select MXC_IPU_V3H if ARCH_MX6Q
	help
	  If you plan to use the Image Processing unit, say
	  Y here. IPU is needed by Framebuffer and V4L2 drivers.

source "drivers/mxc/ipu/Kconfig"
source "drivers/mxc/ipu3/Kconfig"

source "drivers/mxc/ssi/Kconfig"
source "drivers/mxc/dam/Kconfig"
source "drivers/mxc/pmic/Kconfig"
source "drivers/mxc/security/Kconfig"
source "drivers/mxc/hmp4e/Kconfig"
source "drivers/mxc/hw_event/Kconfig"
source "drivers/mxc/vpu/Kconfig"
source "drivers/mxc/asrc/Kconfig"
source "drivers/mxc/bt/Kconfig"
source "drivers/mxc/gps_ioctrl/Kconfig"
source "drivers/mxc/mlb/Kconfig"
source "drivers/mxc/adc/Kconfig"
source "drivers/mxc/amd-gpu/Kconfig"
source "drivers/mxc/thermal/Kconfig"
source "drivers/mxc/mipi/Kconfig"
source "drivers/mxc/hdmi-cec/Kconfig"

config MXC_GPU_VIV
	depends on ARCH_MX6
	tristate "MXC Vivante GPU support"
	---help---
	 Say Y to get the GPU driver support.

choice
	depends on MXC_GPU_VIV
	bool "GPU Driver version"
	default MXC_GPU_VIV_4_1_0

	help 
	Select the GPU driver version that matches your userland libraries

config MXC_GPU_VIV_4_0_0
	bool "v4.0.0"

config MXC_GPU_VIV_4_1_0
	bool "v4.1.0"

config MXC_GPU_VIV_4_1_0a
	bool "v4.1.0 from 3.5.7 kernel"

endchoice

endmenu

endif
```
